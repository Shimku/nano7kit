## nanoapps/apps/pebbleos/overlay/boards/nano7_emery/Kconfig
```kconfig
# SPDX-FileCopyrightText: 2026 Core Devices LLC
# SPDX-License-Identifier: Apache-2.0

config BOARD_NANO7_EMERY
    bool
    default y
    select BOARD_PARTITIONS_NANO7
    select NANO7
```

## nanoapps/apps/pebbleos/overlay/drivers/display/Kconfig.nano
```kconfig
# SPDX-FileCopyrightText: 2026 nano7kit contributors
# SPDX-License-Identifier: Apache-2.0

config DISPLAY_NANO
    bool "NanoApps framebuffer display"
    depends on NANO7
    help
      200x228 ARGB2222 panel, converted to RGB565 for the NanoApps shim.

if DISPLAY_NANO

config DISPLAY_NANO_WIDTH
    int "Width"
    default 200

config DISPLAY_NANO_HEIGHT
    int "Height"
    default 228

endif
```

## nanoapps/apps/pebbleos/overlay/drivers/flash/Kconfig.nano
```kconfig
# SPDX-FileCopyrightText: 2026 nano7kit contributors
# SPDX-License-Identifier: Apache-2.0

config FLASH_NANO
    bool "NanoApps file-backed flash"
    depends on NANO7
    help
      External flash, 4 MiB, stored under /Apps/Data/PebbleOS by the shim.
```

## nanoapps/apps/pebbleos/overlay/drivers/input/Kconfig.nano
```kconfig
# SPDX-FileCopyrightText: 2026 nano7kit contributors
# SPDX-License-Identifier: Apache-2.0

config INPUT_NANO
    bool "NanoApps buttons"
    depends on NANO7
    depends on INPUT
    help
      Back, Up, Select and Down from the NanoApps button map.
```

## nanoapps/apps/pebbleos/overlay/drivers/rng/Kconfig.nano
```kconfig
# SPDX-FileCopyrightText: 2026 nano7kit contributors
# SPDX-License-Identifier: Apache-2.0

config RNG_NANO
    bool "NanoApps software RNG"
    depends on NANO7
    help
      Software generator seeded from the host monotonic clock.
```

## nanoapps/apps/pebbleos/overlay/drivers/rtc/Kconfig.nano
```kconfig
# SPDX-FileCopyrightText: 2026 Nikita Shimkus
# SPDX-License-Identifier: Apache-2.0

config RTC_NANO
    bool "NanoApps RTC"
    depends on NANO7
    help
      RTC following the iPod clock, through the hosted HAL.
```
